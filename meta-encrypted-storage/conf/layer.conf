## meta-encrypted-storage/conf/layer.conf
```bitbake
# We have a conf and classes directory, add to BBPATH
BBPATH .= ":${LAYERDIR}"

# We have recipes-* directories, add to BBFILES
BBFILES += "${LAYERDIR}/recipes-*/*/*.bb \
	${LAYERDIR}/recipes-*/*/*.bbappend"

BBFILE_COLLECTIONS += "encrypted-storage"
BBFILE_PATTERN_encrypted-storage = "^${LAYERDIR}/"
BBFILE_PRIORITY_encrypted-storage = "10"

LAYERDEPENDS_encrypted-storage = "\
    core \
    tpm2 \
"
```

## meta-integrity/conf/layer.conf
```bitbake
# We have a conf and classes directory, add to BBPATH
BBPATH .= ":${LAYERDIR}"

# We have recipes-* directories, add to BBFILES
BBFILES += "${LAYERDIR}/recipes-*/*/*.bb \
	${LAYERDIR}/recipes-*/*/*.bbappend"

BBFILE_COLLECTIONS += "integrity-layer"
BBFILE_PATTERN_integrity-layer = "^${LAYERDIR}/"
BBFILE_PRIORITY_integrity-layer = "10"

IMA_SIGNING_BLACKLIST ??= "${LAYERDIR}/files/ima_signing_blacklist"

BBLAYERS_LAYERINDEX_NAME_integrity-layer = "meta-integrity"

LAYERDEPENDS_integrity-layer = "\
    core \
    signing-key \
    openembedded-layer \
"

LAYERRECOMMENDS_integrity-layer = "\
    tpm2 \
    tpm \
"

BB_BASEHASH_IGNORE_VARS:append = " \
    RPM_FSK_PATH \
"

LAYERSERIES_COMPAT_integrity-layer = "honister kirkstone langdale"
```

## meta-intel-sgx/conf/layer.conf
```bitbake
# We have a conf and classes directory, add to BBPATH
BBPATH .= ":${LAYERDIR}"

# We have recipes-* directories, add to BBFILES
BBFILES += "${LAYERDIR}/recipes-*/*/*.bb \
	${LAYERDIR}/recipes-*/*/*.bbappend"

BBFILE_COLLECTIONS += "intel-sgx"
BBFILE_PATTERN_intel-sgx = "^${LAYERDIR}/"
BBFILE_PRIORITY_intel-sgx = "10"

BBLAYERS_LAYERINDEX_NAME_intel-sgx = "meta-intel-sgx"

LAYERDEPENDS_intel-sgx = "\
    core \
"

LAYERSERIES_COMPAT_intel-sgx = "rocko thud warrior zeus"
```

## meta-tpm/conf/layer.conf
```bitbake
# We have a conf and classes directory, add to BBPATH
BBPATH .= ":${LAYERDIR}"

# We have recipes-* directories, add to BBFILES
BBFILES += "${LAYERDIR}/recipes-*/*/*.bb \
	${LAYERDIR}/recipes-*/*/*.bbappend"

BBFILE_COLLECTIONS += "tpm"
BBFILE_PATTERN_tpm = "^${LAYERDIR}/"
BBFILE_PRIORITY_tpm = "10"

LAYERDEPENDS_tpm = "core"
```
